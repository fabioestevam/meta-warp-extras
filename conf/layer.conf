## conf/layer.conf
```bitbake
# We have a conf and classes directory, add to BBPATH
BBPATH .= ":${LAYERDIR}"

# We have a packages directory, add to BBFILES
BBFILES += "${LAYERDIR}/recipes-*/*/*.bb"
BBFILES += "${LAYERDIR}/recipes-*/*/*.bbappend"

BBFILE_COLLECTIONS += "warpimxextra"
BBFILE_PATTERN_warpimxextra = "^${LAYERDIR}/"
BBFILE_PRIORITY_warpimxextra = "5"

LAYERDEPENDS_warpimxextra = "core warpimxbsp"
LAYERSERIES_COMPAT_warpimxextra = "dunfell"

BBFILES_DYNAMIC += " \
	core:${LAYERDIR}/dynamic-layers/core/*/*/*.bb \
	core:${LAYERDIR}/dynamic-layers/core/*/*/*.bbappend \
	\
	openembedded-layer:${LAYERDIR}/dynamic-layers/openembedded-layer/*/*/*.bb \
	openembedded-layer:${LAYERDIR}/dynamic-layers/openembedded-layer/*/*/*.bbappend \
	"
```
